## boards/arm/custom_stm32h7b0/Kconfig.board
```kconfig
# STM32H7B0VBT FK7B0M1_VBT6 board

# Copyright (c) 2023 Charles Dias <charlesdias.cd@outlook.com>
# SPDX-License-Identifier: Apache-2.0

config BOARD_CUSTOM_STM32H7B0
	bool "Custom board based on FANKE FK7B0M1-VBT6 board V1.0"
	depends on SOC_STM32H7B0XX
```

## boards/arm/custom_stm32h7b0/Kconfig.defconfig
```kconfig
# STM32H7B0VBT board configuration

# Copyright (c) Charles Dias <charlesdias.cd@outlook.com>
# SPDX-License-Identifier: Apache-2.0

if BOARD_CUSTOM_STM32H7B0

config BOARD
	default "custom_stm32h7b0"

endif # BOARD_CUSTOM_STM32H7B0
```
